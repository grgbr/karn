## Config.in
```kconfig
config KARN_ASSERT
	bool "Build Karn with assertions"
	default n

config KARN_BTRACE
	bool "Build Karn with backtrace support"
	default n

config KARN_TEST
	bool "Build Karn unit tests"
	default n

config KARN_PERF
	bool "Build Karn performance tests"
	depends on KARN_TEST
	default n

config KARN_FBMP
	bool "Fixed length bitmap"
	default y

config KARN_FALLOC
	bool "Fixed length chunk allocator"
	default y

config KARN_LCRS
	bool "Left child right sibling tree"
	default n

config KARN_SLIST
	bool "Singly linked list"
	default y

config KARN_SLIST_PERF_EVENTS
	bool
	default KARN_PERF

config KARN_SLIST_BUBBLE_SORT
	bool "Bubble sort on singly linked list"
	select KARN_SLIST
	default y

config KARN_SLIST_SELECTION_SORT
	bool "Selection sort on singly linked list"
	select KARN_SLIST
	default y

config KARN_SLIST_INSERTION_SORT
	bool "Insertion sort on singly linked list"
	select KARN_SLIST
	default y

config KARN_SLIST_MERGE_SORT
	bool "Hybrid merge sort on singly linked list"
	select KARN_SLIST
	select KARN_SLIST_INSERTION_SORT
	default y

config KARN_DLIST
	bool "Doubly linked list"
	default y

config KARN_FBNR_HEAP_UTILS
	bool "Fixed length array based binary heap utilities"
	default n

config KARN_FBNR_HEAP
	bool "Fixed length array based binary heap"
	select KARN_FBNR_HEAP_UTILS
	default y

config KARN_FBNR_HEAP_SORT
	bool "Fixed length array based binary heap sorting"
	select KARN_FBNR_HEAP_UTILS
	default y

config KARN_PBNM_HEAP
	bool "Parented LCRS based binomial heap"
	default y

config KARN_SBNM_HEAP
	bool "Singly linked list based binomial heap"
	select KARN_LCRS
	default y

config KARN_DBNM_HEAP
	bool "Doubly linked list based binomial heap"
	select KARN_DLIST
	default y

config KARN_SPAIR_HEAP
	bool "Singly linked list based pairing heap"
	select KARN_LCRS
	default y

config KARN_FWK_HEAP_UTILS
	bool "Fixed length array based weak heap utilities"
	select KARN_FBMP
	default n

config KARN_FWK_HEAP
	bool "Fixed length array based weak heap"
	select KARN_FWK_HEAP_UTILS
	default y

config KARN_FWK_HEAP_SORT
	bool "Fixed length array based weak heap sorting"
	select KARN_FWK_HEAP_UTILS
	default y

config KARN_FARR_BUBBLE_SORT
	bool "Fixed length array based bubble sorting"
	default y

config KARN_FARR_SELECTION_SORT
	bool "Fixed length array based selection sorting"
	default y

config KARN_FARR_INSERTION_SORT
	bool "Fixed length array based insertion sorting"
	default y

config KARN_FARR_QUICK_SORT_UTILS
	bool "Fixed length array based quick sorting common utilities"
	default n

config KARN_FARR_QUICK_SORT
	bool "Fixed length array based quick sorting"
	select KARN_FARR_QUICK_SORT_UTILS
	default y

config KARN_FARR_INTRO_SORT
	bool "Fixed length array based introspective sorting"
	select KARN_FARR_QUICK_SORT_UTILS
	select KARN_FBNR_HEAP_SORT
	default y
```
